## conf/bblayers.conf.sample
```bitbake
# POKY_BBLAYERS_CONF_VERSION is increased each time build/conf/bblayers.conf
# changes incompatibly
POKY_BBLAYERS_CONF_VERSION = "2"

BBPATH = "${TOPDIR}"
BBFILES ?= ""

BBLAYERS ?= " \
  /home/kaiza/yocto/poky/meta \
  /home/kaiza/yocto/poky/meta-poky \
  /home/kaiza/yocto/poky/meta-yocto-bsp \
  /home/kaiza/yocto/meta-openembedded/meta-python \
  /home/kaiza/yocto/meta-openembedded/meta-networking \
  /home/kaiza/yocto/meta-openembedded/meta-webserver \
  /home/kaiza/yocto/meta-openembedded/meta-perl \
  /home/kaiza/yocto/meta-openembedded/meta-filesystems \
  /home/kaiza/yocto/meta-openembedded/meta-oe \
  /home/kaiza/yocto/meta-security/meta-tpm \
  /home/kaiza/yocto/meta-rauc \
  /home/kaiza/yocto/meta-mingw \
  /home/kaiza/yocto/meta-raspberrypi \
  /home/kaiza/yocto/meta-custom \
  "
```

## conf/distro/common.inc
```bitbake
require conf/distro/poky.conf

# Distro versions for each machine arch
# Controls
DISTRO_VERSION_axcf2152 ?= "2019.6"
DISTRO_VERSION_rfc480-64 ?= "2019.6"
DISTRO_VERSION_axcf3152 ?= "9999.0"
# Gateways
DISTRO_VERSION_ksp0610 ?= "1.0.3"
# HMIs
# CPUs

# Log information on images and packages
INHERIT += "buildhistory"
BUILDHISTORY_COMMIT ?= "1"
USER_CLASSES += "buildstats"

# Prelink images
USER_CLASSES += "image-prelink"

# Optimize lib sizes with mklibs
USER_CLASSES += "image-mklibs"

# A list of packaging systems used in generated images
PACKAGE_CLASSES ?= "package_deb"

# Generate mirror tarballs for sources fetched from version control systems.
# This helps us to create a full source mirror.
BB_GENERATE_MIRROR_TARBALLS ?= "1"

# Create the directory /usr/share/common-licenses for open-source licenses
# and create an license.manifest.
COPY_LIC_DIRS ?= "1"
COPY_LIC_MANIFEST ?= "1"

# A list of preferred providers
include conf/distro/include/default-providers-pxc.inc

# A list of preferred package versions
include conf/distro/include/default-versions-pxc.inc

# A list of maintainers for packages
include conf/distro/include/maintainers-pxc.inc

# Security flags
require conf/distro/include/security_flags-pxc.inc
```

## conf/distro/custom-controls.conf
```bitbake
require conf/distro/custom.conf

DISTRO = "custom"
DISTRO_NAME_append = " for Controls"

DISTRO_FEATURES_DEFAULT_remove = "\
    alsa \
    argp \
    bluetooth \
    irda \
    pcmia \
    usbgadget \
    usbhost \
    wifi \
    nfs \
    zeroconf \
    pci \
    3g \
    nfc \
    x11 \
   "
# DISTRO_FEATURES_DEFAULT = "acl ext2 largefile pcmia xattr"

# default: poky/meta-poky/conf/distro/poky.conf
POKY_DEFAULT_DISTRO_FEATURES_remove = "\
    opengl \
    ptest \
    multiarch \
    wayland \
   "
# POKY_DEFAULT_DISTRO_FEATURES = "largefile vulkan"

# default: poky/meta/conf/bitbake.conf
DISTRO_FEATURES_BACKFILL_CONSIDERED = "\
    pulseaudio \
   "
# DISTRO_FEATURES_BACKFILL = "sysvinit bluez5 gobject-introspection-data ldconfig"

# default: poky/meta-poky/conf/distro/poky.conf
# DISTRO_FEATURES = "${DISTRO_FEATURES_DEFAULT} ${POKY_DEFAULT_DISTRO_FEATURES}"

DISTRO_FEATURES_append_my-raspberrypi3 = "\
    directfb \
   "

PACKAGECONFIG_append_pn-strongswan = " swanctl"
```

## conf/distro/custom-cpu.conf
```bitbake
require conf/distro/custom.conf

DISTRO = "custom"
DISTRO_NAME_append = " for CPUs"
```

## conf/distro/custom.conf
```bitbake
require conf/distro/common.inc

DISTRO = "custom"
DISTRO_NAME = "My Custom Distribution"

# default: poky/meta/conf/distro/include/default-distrovars.inc
DISTRO_FEATURES_DEFAULT_remove = "\
    "

# default: poky/meta-poky/conf/distro/poky.conf
POKY_DEFAULT_DISTRO_FEATURES_remove = "\
   "

# default: poky/meta/conf/bitbake.conf
DISTRO_FEATURES_BACKFILL_CONSIDERED = "\
   "

# default: poky/meta-poky/conf/distro/poky.conf
# DISTRO_FEATURES = "${DISTRO_FEATURES_DEFAULT} ${POKY_DEFAULT_DISTRO_FEATURES}"
```

## conf/distro/include/maintainers-pxc.inc
```bitbake
# PLCnext Maintainers File
#
# This file contains a list of recipe maintainers.
#
# Please submit any patches against recipes in meta to the 
# OE-Core mail list (openembedded-core@lists.openembedded.org)
# For recipes in meta-yocto please use the Poky list (poky@yoctoproject.org)
#
# If you have problems with or questions about a particular recipe, feel
# free to contact the maintainer directly.
#
# The format is as a bitbake variable override for each recipe
#
#	RECIPE_MAINTAINER_pn-<recipe name> = "Full Name <address@domain>"
#
# Please keep this list in alphabetical order.
#
RECIPE_MAINTAINER_pn- = "Full Name <address@domain>"
```

## conf/distro/include/security_flags-pxc.inc
```bitbake
#
# Recipes which fail to compile when elevating -Wformat-security to an error
#
SECURITY_STRINGFORMAT_pn-rauc ?= ""
```

## conf/local.conf.sample
```bitbake
# Set global user variables


# CONF_VERSION is increased each time build/conf/ changes incompatibly
CONF_VERSION = "1"

# Set a machine to target
# conf/machine/<MACHINE>.conf
MACHINE = "raspberrypi3"

# Set a distribution to target
# conf/distro/<DISTRO>.conf
DISTRO = "custom-controls"

PATCHRESOLVE = "noop"

BB_DISKMON_DIRS ??= "\
    STOPTASKS,${TMPDIR},1G,100K \
    STOPTASKS,${DL_DIR},1G,100K \
    STOPTASKS,${SSTATE_DIR},1G,100K \
    STOPTASKS,/tmp,100M,100K \
    ABORT,${TMPDIR},100M,1K \
    ABORT,${DL_DIR},100M,1K \
    ABORT,${SSTATE_DIR},100M,1K \
    ABORT,/tmp,10M,1K"

#SDKMACHINE = "x86_64-mingw32"

#INHERIT+= "toaster"

#INHERIT += "archiver"
#ARCHIVER_MODE[src] = "configured"
#COPYLEFT_LICENSE_EXCLUDE = 'CLOSED'
#COPYLEFT_RECIPE_TYPES = 'target'
```

## conf/machine/include/my-qemuboot-arm.inc
```bitbake
# For runqemu

IMAGE_CLASSES += "qemuboot"

# QEMU Name
QB_SYSTEM_NAME = "qemu-system-arm"

# Memory of QEMU
QB_MEM = "-m 1024"

# QEMU CPU
QB_CPU = "-cpu cortex-a15"

# Kernel Command Line
QB_KERNEL_CMDLINE_APPEND = "console=ttyAMA0"

# Add the 'virtio-rng-pci' device otherwise the guest may run out of entropy
QB_OPT_APPEND += "-object rng-random,filename=/dev/urandom,id=rng0 -device virtio-rng-pci,rng=rng0"

# Virtio Networking support
QB_TAP_OPT = "-netdev tap,id=net0,ifname=@TAP@,script=no,downscript=no"
QB_NETWORK_DEVICE = "-device virtio-net-device,netdev=net0,mac=@MAC@"

KMACHINE_qemuarm = "qemuarma15"
```

## conf/machine/include/my-qemuboot-x86.inc
```bitbake
# For runqemu

IMAGE_CLASSES += "qemuboot"

# QEMU Name
QB_SYSTEM_NAME = "qemu-system-x86_64"

# Memory of QEMU
QB_MEM = "-m 512"

# QEMU CPU
QB_CPU = "-cpu Nehalem -smp 2"
QB_CPU_KVM = "-cpu kvm64 -smp 2"

# Kernel Command Line
QB_KERNEL_CMDLINE_APPEND = "vga=0 uvesafb.mode_option=640x480-32 oprofile.timer=1 uvesafb.task_timeout=-1"

# Add the 'virtio-rng-pci' device otherwise the guest may run out of entropy
QB_OPT_APPEND += "-object rng-random,filename=/dev/urandom,id=rng0 -device virtio-rng-pci,rng=rng0"

# Virtio Networking support
QB_TAP_OPT = "-netdev tap,id=net0,ifname=@TAP@,script=no,downscript=no"
QB_NETWORK_DEVICE = "-device virtio-net-device,netdev=net0,mac=@MAC@"
```

## conf/machine/my-am57xx-evm.conf
```bitbake
#@TYPE: Machine
#@NAME: My AM57xx EVM
#@DESCRIPTION: Machine configuration for the TI AM57xx EVM

require conf/machine/am57xx-evm.conf

RDEPENDS_${KERNEL_PACKAGE_NAME}-base = "${KERNEL_PACKAGE_NAME}-image"

PREFERRED_PROVIDER_virtual/kernel ?= "linux-ti-staging-rt"
```

## conf/machine/my-qemuarm.conf
```bitbake
#@TYPE: Machine
#@NAME: My QEMU ARM machine
#@DESCRIPTION: Machine configuration for running my ARM system on QEMU

require conf/machine/include/my-qemuboot-arm.inc
require conf/machine/include/qemuarm.inc

MACHINEOVERRIDES =. "qemuarm:"

PREFERRED_PROVIDER_virtual/kernel ?= "linux-yocto-rt"
```

## conf/machine/my-qemux86-64.conf
```bitbake
#@TYPE: Machine
#@NAME: My QEMU x86-64 machine
#@DESCRIPTION: Machine configuration for running my x86-64 system on QEMU

require conf/machine/include/qemux86-64.inc

DEFAULTTUNE ?= "corei7-64"
require conf/machine/include/tune-corei7.inc
require conf/machine/include/my-qemuboot-x86.inc

MACHINEOVERRIDES =. "qemux86-64:"

PREFERRED_PROVIDER_virtual/kernel ?= "linux-yocto-rt"
```

## conf/machine/my-raspberrypi3.conf
```bitbake
#@TYPE: Machine
#@NAME: My RaspberryPi 3 Development Board
#@DESCRIPTION: Machine configuration for my RaspberryPi 3 in 64 bits mode

require conf/machine/raspberrypi3-64.conf

RDEPENDS_${KERNEL_PACKAGE_NAME}-base = "${KERNEL_PACKAGE_NAME}-image"

TARGET_FEATURES = "test"
```

## meta-raspberrypi_bsp/conf/layer.conf
```bitbake
# We have a conf and classes directory, add to BBPATH
BBPATH .= ":${LAYERDIR}"

# We have recipes-* directories, add to BBFILES
BBFILES += "${LAYERDIR}/recipes-*/*/*.bb \
	        ${LAYERDIR}/recipes-*/*/*.bbappend"

BBFILE_COLLECTIONS += "raspberry"
BBFILE_PATTERN_raspberry = "^${LAYERDIR}/"
BBFILE_PRIORITY_raspberry = "15"

LAYERSERIES_COMPAT_raspberry = "warrior"
```
